## sampler-libiio/Config.in
```kconfig
config BR2_PACKAGE_SAMPLER_LIBIIO
    bool "Sampler LibIIO"
    select BR2_PACKAGE_LIBXML2
    select BR2_TOOLCHAIN_HAS_THREADS
    select BR2_PACKAGE_LIBAIO
    select BR2_PACKAGE_ZSTD
    help
      LibIIO v1.0 and IIO Daemon.
```

## sampler/Config.in
```kconfig
config BR2_PACKAGE_SAMPLER
    bool "Sampler"
    select BR2_PACKAGE_SAMPLER_LIBIIO
    help
      Sampler package.
```
